## arch/little64/Kconfig
```kconfig
config LITTLE64
	def_bool y
	select OF
	select OF_EARLY_FLATTREE
	select GENERIC_BUILTIN_DTB
	select GENERIC_IRQ_CHIP
	select GENERIC_IRQ_PROBE
	select GENERIC_IRQ_SHOW
	select SPARSE_IRQ
	select IRQ_DOMAIN
	select GENERIC_CPU_DEVICES
	select GENERIC_IOREMAP
	select COMMON_CLK
	select GENERIC_CLOCKEVENTS_BROADCAST
	select TIMER_OF
	select MODULES_USE_ELF_RELA
	select ARCH_WANT_DEFAULT_TOPDOWN_MMAP_LAYOUT
	select THREAD_INFO_IN_TASK
	select HAVE_REGS_AND_STACK_ACCESS_API
	select GENERIC_CSUM
	select STACKTRACE_SUPPORT
	select GENERIC_HWEIGHT
	select NO_IOPORT_MAP
	select FIX_EARLYCON_MEM
	select ARCH_HAS_ATOMIC64_DEC_IF_POSITIVE
	select HAVE_ARCH_MMAP_RND_BITS
	select GENERIC_IRQ_ENTRY

config CPU_LITTLE_ENDIAN
	def_bool y

config MMU
	def_bool y

config FIX_EARLYCON_MEM
	def_bool y

config 64BIT
	def_bool y

config BUILTIN_DTB_NAME
	string "Built-in Device Tree Blob name"
	default "little64"

config NR_CPUS
	int "Number of CPUs"
	default 1

config ARCH_LITTLE64
	bool
	default y

config BUILTIN_DTB
	bool "Use built-in device tree"
	default y
	help
	  For the initial port, use a device tree compiled into the kernel
	  rather than passed by the bootloader.

config PGTABLE_LEVELS
	int
	default 3

config ARCH_MMAP_RND_BITS_MIN
	default 18

config ARCH_MMAP_RND_BITS_MAX
	default 33

source "kernel/Kconfig.hz"
```

## arch/little64/Kconfig.debug
```kconfig
# Debug configuration for Little-64

config DEBUG_STACK_USAGE
	bool "Enable stack usage debugging"
	depends on DEBUG_KERNEL
	help
	  This option will cause the kernel to monitor the amount of stack
	  used in the kernel and will issue a warning if the user kernel
	  stack usage exceeds a threshold.
```

## arch/little64/configs/little64_defconfig
```kconfig
# Minimal defconfig for Little-64 architecture

CONFIG_LITTLE64=y
CONFIG_64BIT=y
CONFIG_MMU=y
CONFIG_OF=y
CONFIG_OF_EARLY_FLATTREE=y
CONFIG_GENERIC_BUILTIN_DTB=y
CONFIG_BUILTIN_DTB=y
CONFIG_BUILTIN_DTB_NAME="little64"

# Serial console
CONFIG_SERIAL_8250=y
CONFIG_SERIAL_8250_CONSOLE=y
CONFIG_SERIAL_OF_PLATFORM=y
CONFIG_SERIAL_8250_NR_UARTS=4
CONFIG_CONSOLE_LOGLEVEL_DEFAULT=8

# Kernel features
CONFIG_PRINTK=y
CONFIG_BLOCK=y
CONFIG_BLK_DEV_INITRD=y
CONFIG_LITTLE64_PVBLK=y
CONFIG_EXT2_FS=y
CONFIG_EMBEDDED=y
CONFIG_EXPERT=y
# CONFIG_UNIX98_PTYS is not set
# CONFIG_LEGACY_PTYS is not set

# IRQs
CONFIG_GENERIC_IRQ_CHIP=y
CONFIG_SPARSE_IRQ=y
CONFIG_IRQ_DOMAIN=y

# Time/clock
CONFIG_GENERIC_CLOCKEVENTS_BROADCAST=y
CONFIG_COMMON_CLK=y
CONFIG_NO_HZ=y
CONFIG_NO_HZ_IDLE=y
CONFIG_HZ_250=y
CONFIG_HZ=250

# Device tree
CONFIG_OF_ADDRESS=y
CONFIG_OF_PLATFORM=y

# Root disk exposure
CONFIG_DEVTMPFS=y

# ELF
CONFIG_MODULES_USE_ELF_RELA=y

# Paging
CONFIG_PGTABLE_LEVELS=3

# Misc
CONFIG_NO_IOPORT_MAP=y
CONFIG_GENERIC_IOREMAP=y
CONFIG_GENERIC_CSUM=y
```
